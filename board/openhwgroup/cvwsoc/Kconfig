## board/openhwgroup/cvwsoc/Kconfig
```kconfig
if TARGET_OPENHWGROUP_CVWSOC

config SYS_BOARD
	default "cvwsoc"

config SYS_VENDOR
	default "openhwgroup"

config SYS_CONFIG_NAME
        default "openhwgroup_cvwsoc"

config SYS_CPU
	default "generic"

config SPL_TEXT_BASE
	default 0x08000000

config BOARD_SPECIFIC_OPTIONS # dummy
	def_bool y
	select GENERIC_RISCV

endif
```

## board/openhwgroup/cvwsoc_genesys2/Kconfig
```kconfig
if TARGET_OPENHWGROUP_CVWSOC_GENESYS2

config SYS_BOARD
	default "cvwsoc_genesys2"

config SYS_VENDOR
	default "openhwgroup"

config SYS_CONFIG_NAME
        default "openhwgroup_cvwsoc_genesys2"

config SYS_CPU
	default "generic"

config SPL_TEXT_BASE
	default 0x08000000

config BOARD_SPECIFIC_OPTIONS # dummy
	def_bool y
	select GENERIC_RISCV

endif
```

## board/openhwgroup/cvwsoc_nexysa7/Kconfig
```kconfig
if TARGET_OPENHWGROUP_CVWSOC_NEXYSA7

config SYS_BOARD
	default "cvwsoc_nexysa7"

config SYS_VENDOR
	default "openhwgroup"

config SYS_CONFIG_NAME
        default "openhwgroup_cvwsoc_nexysa7"

config SYS_CPU
	default "generic"

config SPL_TEXT_BASE
	default 0x08000000

config BOARD_SPECIFIC_OPTIONS # dummy
	def_bool y
	select GENERIC_RISCV

endif
```

## configs/openhwgroup_cvwsoc_rv32_defconfig
```kconfig
CONFIG_RISCV=y
CONFIG_RISCV_ISA_ZICBOM=y
CONFIG_RISCV_ISA_ZBB=y
CONFIG_TEXT_BASE=0x80200000
CONFIG_SYS_MALLOC_LEN=0x800000
CONFIG_SYS_BOOTM_LEN=0x3000000
CONFIG_HAS_CUSTOM_SYS_INIT_SP_ADDR=y
CONFIG_CUSTOM_SYS_INIT_SP_ADDR=0x82000000
CONFIG_DEFAULT_DEVICE_TREE="cvwsoc-genesys2rv32"
CONFIG_SYS_LOAD_ADDR=0x80200000
CONFIG_TARGET_OPENHWGROUP_CVWSOC=y
CONFIG_ARCH_RV32I=y
CONFIG_RISCV_SMODE=y
CONFIG_OF_BOARD_SETUP=y
CONFIG_BOOTDELAY=1
CONFIG_USE_BOOTCOMMAND=y
CONFIG_DISPLAY_CPUINFO=y
CONFIG_SPL_SPI_FLASH_MTD=y
CONFIG_CMD_GPT=y
# CONFIG_RANDOM_UUID is not set
CONFIG_CMD_MMC=y
CONFIG_CMD_MTD=y
CONFIG_CMD_PART=y
CONFIG_OF_EMBED=y
CONFIG_MMC=y
CONFIG_MMC_WRITE=y
CONFIG_MMC_SPI=y
CONFIG_SYS_NS16550=y
CONFIG_SPI=y
CONFIG_SPI_SIFIVE=y
CONFIG_LITEETH=y
CONFIG_NET_RANDOM_ETHADDR=y
CONFIG_CMD_DHCP=y
CONFIG_CMD_PING=y
CONFIG_DM_RESET=y
CONFIG_SANDBOX_MBOX=y
CONFIG_SYSCON=y
CONFIG_USB=y
CONFIG_USB_OHCI_GENERIC=y
CONFIG_USB_OHCI_HCD=y
CONFIG_USB_STORAGE=y
CONFIG_USB_MUSB_GADGET=y
CONFIG_USB_HOST_ETHER=y
CONFIG_USB_ETHER_ASIX=y
CONFIG_USB_ETHER_ASIX88179=y
CONFIG_USB_ETHER_RTL8152=y
CONFIG_CMD_USB=y
CONFIG_CMD_SPI=y
CONFIG_CMD_MEMTEST=y
CONFIG_CMD_CACHE=y
CONFIG_CMD_BOOTZ=y
CONFIG_MMC_SDHCI=y
CONFIG_MMC_SDHCI_NPCM=y
```
